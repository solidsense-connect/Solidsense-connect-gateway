## poky/meta-cip-sr-imx8mnc/conf/machine/imx8mnc.conf
```bitbake
#@TYPE: Machine
#@NAME: Solidrun imx8mnc
#@DESCRIPTION: Machine configuration for running on Solidsense

DEFAULTTUNE = "cortexa53"
require conf/machine/include/tune-cortexa53.inc

IMAGE_FSTYPES ?= "tar.gz"

# U-boot related variables
EXTRA_IMAGEDEPENDS += "u-boot"
#UBOOT_MACHINE = "imx8mn_solidrun_defconfig"
UBOOT_MACHINE = "imx8mq_evk_defconfig"
UBOOT_SUFFIX = "img"
BOOTLOADER_GIT_PROTOCOL = "https"
BOOTLOADER_GIT_URI = "git://github.com"
BOOTLOADER_GIT_PREFIX = "nxp-imx/"
UBOOT_GIT_REPO = "${BOOTLOADER_GIT_URI}/${BOOTLOADER_GIT_PREFIX}u-boot.git;branch=imx_v2020.04_5.4.70_2.3.0;protocol=${BOOTLOADER_GIT_PROTOCOL}"
#TODO ADD UBOOT PATCHES
UBOOT_EXTLINUX = "0"
#PREFERRED_PROVIDER_virtual/u-boot ?= "u-boot-imx" 

# Linux kernel related variables
LINUX_GIT_PROTOCOL = "https"
LINUX_GIT_URI = "git://github.com"
LINUX_GIT_REPO = "linux-imx"
LINUX_GIT_PREFIX = "nxp-imx/"
LINUX_GIT_SRCREV = "rel_imx_5.4.47_2.2.0"
LINUX_GIT_BRANCH = "imx_5.4.47_2.2.0"
LINUX_DEFCONFIG = "imx_v8_defconfig"
KERNEL_DEVICETREE = "freescale/imx8mn-compact.dtb"
KERNEL_IMAGETYPE = "Image"
VIRTUAL_KERNEL ?= "linux-imx"

MACHINE_ESSENTIAL_EXTRA_RDEPENDS += "kernel-devicetree kernel-image-image kernel-modules"
MACHINE_ESSENTIAL_EXTRA_RDEPENDS += "linux-firmware-imx-sdma-imx7d firmware-wireless-imx8mnc"
IMAGE_INSTALL_remove += "connectd"

# IMX8MNC specific recipes
IMAGE_INSTALL_append += "rs485conf can-utils python-can python-can-j1939"

SERIAL_CONSOLE = "115200 ttymxc1"
SERIAL_CONSOLES = "115200;ttymxc1"

# Mender config
MENDER_STORAGE_DEVICE = "/dev/mmcblk2"
# actually size 7456, added 2 to ensure partitions are correctly made
MENDER_STORAGE_TOTAL_SIZE_MB = "7458"
ARTIFACTIMG_FSTYPE = "ext4"
SDIMG_ROOTFS_TYPE = "ext4"
IMAGE_ROOTFS_SIZE = "1524"

MENDER_PARTITION_ALIGNMENT = "1048576"
MENDER_BOOT_PART = ""
MENDER_BOOT_PART_SIZE_MB = "0"
# Use mender SWAP variables to set aside partition for overlayfs
MENDER_SWAP_PART_SIZE_MB = "64"
MENDER_ROOTFS_PART_A = "${MENDER_STORAGE_DEVICE_BASE}1"
MENDER_ROOTFS_PART_B = "${MENDER_STORAGE_DEVICE_BASE}2"
MENDER_DATA_PART = "${MENDER_STORAGE_DEVICE_BASE}4"
MENDER_DATA_PART_SIZE_MB = "4343"
MENDER_PARTITIONING_OVERHEAD_KB = "0"

#MENDER_SERVER_URL = "https://mender.solidsense.io" # moved to environment variable
FILESEXTRAPATHS_prepend_pn-mender := "${TOPDIR}/../meta-cip-sr-common/mender-cert:"
SRC_URI_append_pn-mender = " file://artifact-verify-key.pem"
MENDER_UBOOT_ENV_STORAGE_DEVICE_OFFSET = ""
MENDER_UBOOT_ENV_STORAGE_DEVICE_OFFSET_1 = "0xFE000"
MENDER_UBOOT_ENV_STORAGE_DEVICE_OFFSET_2 = "0xFC000"
BOOTENV_SIZE = "8192"
MENDER_DATA_PART_FSTAB_OPTS = "defaults"
MENDER_DATA_PART_FSTYPE = "ext4"
```
